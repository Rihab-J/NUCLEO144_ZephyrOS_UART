## prj.conf
```kconfig
CONFIG_GPIO=y
CONFIG_SERIAL=y
CONFIG_UART_INTERRUPT_DRIVEN=y
```

## src/main.c
```c
#include "serial_comm.h"
static volatile bool data_received;
void main(void)
{
	struct device *uart;
	uart = device_get_binding(my_serial);

	if (!uart) {
		printk("Cannot find myuart uart(%s)!\n", my_serial);
		return;
	}
    
	serial_comm_config();
	serial_comm_send_data(uart, "hello\n"); 
	uart_irq_callback_set(uart, serial_comm_callback);
	
	uart_irq_rx_enable(uart);

	printk("Please send characters to serial console\n");
	read_data();

	
	//uart_irq_rx_disable(uart); /*Verify uart_irq_rx_disable() */
	
	while (1) {
	}
}
```

## src/serial_comm.h
```c
#include <device.h>
#include <drivers/uart.h>
#include <kernel.h>

#define my_serial CONFIG_UART_CONSOLE_ON_DEV_NAME 
void serial_comm_config(void); 
void serial_comm_send_data(struct device *uart, char * szStr);
void serial_comm_callback(struct device *dev,void *user_data);
void read_data(void);
```

## src/serial_comm_callback.c
```c
#include "serial_comm.h"
#include <string.h>

#define SLEEPTIME 100

struct message
{
	uint8_t recData;
};
char __aligned(4) my_msgq_buffer[10 * sizeof(char)];
K_MSGQ_DEFINE(my_msgq, sizeof(char), 10, 4);

void serial_comm_callback(struct device *uart_dev, void *user_data)
{
	struct message data;

	if (!uart_irq_update(uart_dev))
	{
		printk("retval should always be 1");
		return;
	}
	if (uart_irq_rx_ready(uart_dev))
	{
		uart_fifo_read(uart_dev, &data.recData, 1);
	}

	while (k_msgq_put(&my_msgq, &data, K_NO_WAIT) != 0)
	{
		/* message queue is full: purge old data & try again */
		printk("message queue is full: purging old data & try again");
		k_msgq_purge(&my_msgq);
	}
}
void read_data(void)
{
	struct message received_message;

	while (1)
	{

		/* get a data item */
		if (k_msgq_get(&my_msgq, &received_message, K_FOREVER) == 0)
		{
			printk("%c", received_message.recData);
		}
	}
}
```

## src/serial_comm_send_data.c
```c
#include "serial_comm.h"
#include <string.h>

void serial_comm_send_data(struct device *uart, char * szStr) {
    size_t i;
    unsigned char temp;
    for (i = 0; i < strlen(szStr); i++) {
        temp = szStr[i];
        uart_poll_out(uart, temp);
    }
}
```
